## drivers/net/wireless/nmi/Kconfig
```kconfig
choice
    depends on NMC1XXX_WIFI_MODULE
    prompt "Wi-Fi chipset type"
    default NMC1000_WIFI_CHIP

	config NMC1000_WIFI_CHIP
	    bool "NMC1000 without bluetooth"
	config NMC1100_WIFI_CHIP
	    bool "NMC1100 with bluetooth"

endchoice

choice
    depends on NMC1XXX_WIFI_MODULE
    prompt "Wi-Fi bus type"
    default NMC1XXX_USE_SDIO
    
	config NMC1XXX_USE_SDIO_BUS
	    bool "communication by SDIO"
#	    depends on AM_WIFI_SD_MMC || SD_MMC && SDIO
	config NMC1XXX_USE_SPI_BUS
	    bool "communication by SPI"
endchoice

choice
    depends on NMC1XXX_WIFI_MODULE
    prompt "NMC1000 Wi-Fi Driver Version"
    default NMC1XXX_SPI_722_VERSION

	config NMC1XXX_SPI_722_VERSION
		bool "Select the Realese 7.22 Driver for NMC1000 "
	config NMC1XXX_SPI_930_VERSION
		bool "Select the Realese 9.30 Driver for NMC1000 "
	config NMC1XXX_SPI_722_FREQUENCY_TEST_VERSION
		bool "Select the FREQUENCY TEST 7.22 Driver for NMC1000 "
	config NMC1XXX_936_VERSION
	    bool "Select NMC1000 9.36 Version"
	config NMC1XXX_936_JOHNNY_VERSION
	    bool "Select NMC1000 9.36 Version from Johnny."
	config NMC1XXX_937_JOHNNY_VERSION
	    bool "Select NMC1000 9.37 Version from Johnny."
endchoice



config SDIO_HARD_IRQ
        depends on NMC1XXX_WIFI_MODULE && NMC1XXX_USE_SDIO
        bool "SDIO HARD IRQ"
        default n
        ---help---
          hard irq wake up polling process

#config NMC1XXX_WIFI_CONTROL_FUNC
#        bool "Use NMC1XXX_wlan device"
#        depends on NMC1XXX_WIFI_MODULE
#        default n
#        ---help---
#           Use this option to get various parameters from architecture specific
#           NMC1XXX_wlan platform device. Say n if unsure.

config NMC1XXX_HW_OOB_INTR
        bool "Use out of band interrupt"
        depends on NMC1XXX_WIFI_MODULE && NMC1XXX_USE_SDIO_BUS
        default n
        ---help---
           Use out of band interrupt for wake on wireless.

#config NMC1XXX_OOB_INTR_ONLY
#        bool "Use out of band interrupt only"
#        depends on NMC1XXX_WIFI_MODULE && NMC1XXX_USE_SDIO_BUS
#        default n
#        ---help---
#           Use out of band interrupt for all interrupts(including SDIO interrupts).

config NMC1XXX_ENABLE_DEBUGFS
	bool "Export debugfs for NMC1XXX status"
	depends on NMC1XXX_WIFI_MODULE
	default n
	---help---
	   Export status information via debugfs.
```

## drivers/tchip/Kconfig
```kconfig
menu "T-Chip Products Configuration"

menu "T-Chip USB info Select"

config TCHIP_USB_VENDOR
       string "USB Controller Vendor"
       default "T-Chip"
       help
               Changes according to the requirements of your product.

config TCHIP_USB_PRODUCT
       string "USB Controller Product"
       default "T-Chip"
       help
               Changes according to the requirements of your product.

config TCHIP_USB_INFO
       string "USB Information"
       default "T-Chip USB Device"
       help
               Changes according to the requirements of your product.
       
endmenu
#########################################
#           T-Chip Series Boards        #
choice
	prompt "Select Machine Model"
	default TCHIP_MACH_DEFAULT

	config TCHIP_MACH_DEFAULT
		bool "Unknow tchip RK30 Machine"

	config TCHIP_MACH_TR726C
		bool "TR726C ,Public 7' Machine "
		select TCHIP_MACHINE
		select KCONFIG_DDR_TYPE_KINGSTON

endchoice


#############################3 
#add tchip function
#############################

choice
	prompt "Select Tchip TR726C Customer"
	depends on TCHIP_MACH_TR726C
	default TCHIP_TR726C_CUSTOMER_PUBLIC

	config TCHIP_TR726C_CUSTOMER_PUBLIC
		bool " Tchip Customer -- Select PUBLIC"
		#---------- ddr --------
		#select KCONFIG_DDR_TYPE_KINGSTON
		#----------- tp --------
		select TCHIP_TP_FEICU
		#----------- camera -----
		select TCHIP_CAM_ALL
	config TCHIP_TR726C_CUSTOMER_JINGHUA
		bool " Tchip Customer -- Select JING HUA"
		select TCHIP_TP_FEICU
		select TCHIP_CAM_B_GC0308
		select TCHIP_CAM_F_GC0329
		select TCHIP_CAM_B_SP0838
		select TCHIP_CAM_F_SP0838
	config TCHIP_TR726C_CUSTOMER_CUBE
		bool " Tchip Customer -- Select CUBE"
		select TCHIP_TP_FEICU
		select TCHIP_CAM_F_GC0308
		select TCHIP_CAM_F_SP0838
	config TCHIP_TR726C_CUSTOMER_GBXY
		bool " Tchip Customer -- Select Gou Bang Xing Ye"
		select TCHIP_TP_FEICU
		select TCHIP_CAM_F_GC0328
	config TCHIP_TR726C_CUSTOMER_AIPU
		bool " Tchip Customer -- Select AI PU"
		select TCHIP_TP_FEICU
		select TCHIP_CAM_F_GC0311
		select TCHIP_CAM_F_SP0A19
		select TCHIP_CAM_B_BF3920
		select TCHIP_CAM_B_BF3703
		select TCHIP_CAM_B_SP0A19
	config TCHIP_TR726C_CUSTOMER_HUIKE
		bool " Tchip Customer -- Select Hui Ke"
		select TCHIP_TP_FEICU
		select TCHIP_CAM_B_GC2035
		select TCHIP_CAM_F_GC0309
	config TCHIP_TR726C_CUSTOMER_XFH
		bool " Tchip Customer -- Select xin fei hong"
		select TCHIP_TP_FEICU
		select TCHIP_CAM_F_SIV121D
		select TCHIP_CAM_B_SIV121D
		select TCHIP_CAM_F_GC0328
		select TCHIP_CAM_B_GC2035
	config TCHIP_TR726C_CUSTOMER_FUGE_IBALL
		bool " Tchip Customer -- Select Fu Ge - Iball"
		select TCHIP_TP_FEICU
		select TCHIP_CAM_ALL
endchoice

#------------DDR type----------------
config KCONFIG_DDR_TYPE_SAMSUNG
		bool
config KCONFIG_DDR_TYPE_KINGSTON
		bool
config KCONFIG_DDR_TYPE_ELIXIR
		bool

choice
	prompt "Select CUSTOMER DDR3 TYPE"
	default  TCHIP_DDR_TYPE_SAMSUNG

	config  TCHIP_DDR_TYPE_SAMSUNG
		bool  "samsung ddr"
		depends on KCONFIG_DDR_TYPE_SAMSUNG
	config  TCHIP_DDR_TYPE_KINGSTON
		bool  "kingston ddr"
		depends on KCONFIG_DDR_TYPE_KINGSTON
	config  TCHIP_DDR_TYPE_ELIXIR
		bool  "elixir ddr"
		depends on KCONFIG_DDR_TYPE_ELIXIR
endchoice

#--------------- camera ----------------
config TCHIP_CAM_ALL
		bool
config TCHIP_CAM_B_BF3920
		bool
config TCHIP_CAM_B_BF3703
		bool
config TCHIP_CAM_B_GC2035
		bool
config TCHIP_CAM_B_GC0308
		bool
config TCHIP_CAM_B_SP0838
		bool
config TCHIP_CAM_B_SP0A19
		bool
config TCHIP_CAM_B_SIV121D
		bool
config TCHIP_CAM_B_SP2518
		bool

config TCHIP_CAM_F_GC0308
		bool
config TCHIP_CAM_F_GC0328
		bool
config TCHIP_CAM_F_GC0329
		bool
config TCHIP_CAM_F_GC0309
		bool
config TCHIP_CAM_F_GC0311
		bool
config TCHIP_CAM_F_SP0838
		bool
config TCHIP_CAM_F_SP0A19
		bool
config TCHIP_CAM_F_SIV121D
		bool


#---------------- TP type --------------
config TCHIP_TP_FEICU
		bool
config TCHIP_TP_ZHONGCU
		bool

#---------------- Lcd ------------------

config TCHIP_MIX_HDMD
	default n
	bool "Tchip Machine Mix HD and MD Reselution "
	---help---
	  Define HD or MD Machine Reselution by add [tchip_resolution=HD/MD] in parameter file.






endmenu
```
